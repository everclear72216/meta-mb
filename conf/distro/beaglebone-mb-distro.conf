## conf/distro/beaglebone-mb-distro.conf
```bitbake
LOCALCONF_VERSION = "2"

TARGET_VENDOR = "-element14"

DISTRO = "beaglebone-mb-distro"
DISTRO_NAME = "Martin Bertsche's BeagleBone Distribution"
DISTRO_VERSION = "0.1"
DISTRO_VERSION[vardepsexclude] = "DATE"
DISTRO_CODENAME = "rocko"
DISTRO_FEATURES = "argp ext4 vfat largefile usbhost zeroconf opengl wayland systemd pam nfs ${DISTRO_FEATURES_LIBC}"
DISTRO_FEATURES_BACKFILL_CONSIDERED += "sysvinit"
DISTRO_EXTRA_RECOMMENDS += " kernel-modules"

SDK_TITLE = "${DISTRO}"
SDK_VENDOR = "-mb"
SDK_VERSION := "${@'${DISTRO_VERSION}'.replace('snapshot-${DATE}', 'snapshot')}"
SDK_VERSION[vardepsexclude] = "DATE"
SDK_NAME = "${DISTRO}-${TCLIBC}-${SDK_ARCH}-${IMAGE_BASENAME}-${TUNE_PKGARCH}"

TCLIBCAPPEND ?= ""

IMAGE_LINGUAS ?= "de-de"
IMAGE_OVERHEAD_FACTOR = "1"
IMAGE_ROOTFS_SIZE = "300000"

VIRTUAL-RUNTIME_dev_manager ?= "systemd"
VIRTUAL-RUNTIME_init_manager ?= "systemd"
VIRTUAL-RUNTIME_initscripts ?= "systemd-compat-units"
VIRTUAL-RUNTIME_login_manager ?= "systemd"

QT_PROVIDER ?= "qt5"

PREFERRED_PROVIDER_virtual/egl ?= "ti-sgx-ddk-um"
PREFERRED_PROVIDER_virtual/libgles1 ?= "ti-sgx-ddk-um"
PREFERRED_PROVIDER_virtual/libgles2 ?= "ti-sgx-ddk-um"

PREFERRED_PROVIDER_libgbm ?= "libgbm"
PREFERRED_PROVIDER_libgbm-dev ?= "libgbm"

PREFERRED_PROVIDER_virtual/libgl ?= "mesa-gl"
PREFERRED_PROVIDER_virtual/mesa ?= "mesa-gl"

OELAYOUT_ABI = "12"

require conf/distro/include/no-static-libs.inc
require conf/distro/include/yocto-uninative.inc

INHERIT += "uninative"
```

## conf/layer.conf
```bitbake
# We have a conf and classes directory, add to BBPATH
BBPATH .= ":${LAYERDIR}"

# We have recipes-* directories, add to BBFILES
BBFILES += "${LAYERDIR}/recipes-*/*/*.bb ${LAYERDIR}/recipes-*/*/*.bbappend"

BBFILE_COLLECTIONS += "mb"
BBFILE_PATTERN_mb = "^${LAYERDIR}/"
BBFILE_PRIORITY_mb = "7"
```

## conf/machine/beaglebone-mb-board.conf
```bitbake
SOC_FAMILY = "ti335x"
TARGET_ARCH = "arm"
TARGET_PRODUCT = "${SOC_FAMILY}"
DEFAULT_TUNE ?= "cortexa8hf-neon"

require conf/machine/include/ti33x.inc

PREFERRED_PROVIDER_virtual/kernel ?= "linux-ti-staging"
PREFERRED_VERSION_linux-ti-staging ?= "4.9%"

PREFERRED_PROVIDER_virtual/bootloader ?= "u-boot-ti-staging"
PREFERRED_PROVIDER_u-boot ?= "u-boot-ti-staging"
PREFERRED_VERSION_u-boot-ti-staging ?= "2017.01%"

UBOOT_ENTRYPOINT = "0x80008000"
UBOOT_LOADADDRESS = "0x80008000"
UBOOT_MACHINE = "am335x_boneblack_config"

EXTRA_IMAGEDEPENDS += "u-boot"

SERIAL_CONSOLES = "115200;ttyS0 115200;ttyO0"

MACHINE_GUI_CLASS = "smallscreen"
MACHINE_FEATURES += "touchscreen ext4 serial usbhost vfat"

IMAGE_FSTYPES = "tar.xz ext4"
```
